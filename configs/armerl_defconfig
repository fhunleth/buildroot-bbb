## configs/armerl_defconfig
```kconfig
BR2_arm=y
BR2_cortex_a8=y
BR2_ARM_FPU_VFPV3=y
BR2_CCACHE=y
BR2_TOOLCHAIN_EXTERNAL=y
BR2_ENABLE_LOCALE_PURGE=y
BR2_ENABLE_LOCALE_WHITELIST="C"
BR2_ROOTFS_DEVICE_CREATION_DYNAMIC_DEVTMPFS=y
BR2_INIT_NONE=y
BR2_TARGET_GENERIC_GETTY_PORT="ttyAMA0"
# BR2_TARGET_GENERIC_REMOUNT_ROOTFS_RW is not set
BR2_ROOTFS_OVERLAY="board/beagleboneblack/rootfs-additions"
BR2_ROOTFS_POST_BUILD_SCRIPT="board/beagleboneblack/pre-createfs.sh"
BR2_PACKAGE_BUSYBOX_CONFIG="board/armerl/busybox-1.21.config"
BR2_PACKAGE_E2FSPROGS=y
# BR2_PACKAGE_E2FSPROGS_BADBLOCKS is not set
# BR2_PACKAGE_E2FSPROGS_CHATTR is not set
# BR2_PACKAGE_E2FSPROGS_DUMPE2FS is not set
# BR2_PACKAGE_E2FSPROGS_E2FREEFRAG is not set
# BR2_PACKAGE_E2FSPROGS_E2FSCK is not set
# BR2_PACKAGE_E2FSPROGS_E2LABEL is not set
# BR2_PACKAGE_E2FSPROGS_E2UNDO is not set
# BR2_PACKAGE_E2FSPROGS_FILEFRAG is not set
# BR2_PACKAGE_E2FSPROGS_FINDFS is not set
# BR2_PACKAGE_E2FSPROGS_FSCK is not set
# BR2_PACKAGE_E2FSPROGS_LOGSAVE is not set
# BR2_PACKAGE_E2FSPROGS_LSATTR is not set
# BR2_PACKAGE_E2FSPROGS_MKLOSTFOUND is not set
# BR2_PACKAGE_E2FSPROGS_TUNE2FS is not set
# BR2_PACKAGE_E2FSPROGS_UUIDGEN is not set
BR2_PACKAGE_AM335X_PRU_PACKAGE=y
BR2_PACKAGE_ERLANG=y
BR2_PACKAGE_ERLANG_GOLDRUSH=y
BR2_PACKAGE_ERLINIT=y
BR2_PACKAGE_OPENSSL=y
BR2_PACKAGE_NCURSES=y
BR2_PACKAGE_HOST_AM335X_PRU_PACKAGE=y
BR2_TARGET_ROOTFS_EXT2=y
BR2_TARGET_ROOTFS_TAR_GZIP=y
BR2_LINUX_KERNEL=y
BR2_LINUX_KERNEL_CUSTOM_VERSION=y
BR2_LINUX_KERNEL_CUSTOM_VERSION_VALUE="3.10.7"
BR2_LINUX_KERNEL_USE_CUSTOM_CONFIG=y
BR2_LINUX_KERNEL_CUSTOM_CONFIG_FILE="board/armerl/linux-3.10.config"
BR2_LINUX_KERNEL_ZIMAGE=y
```

## configs/bbberl_defconfig
```kconfig
BR2_arm=y
BR2_cortex_a8=y
BR2_KERNEL_HEADERS_VERSION=y
BR2_DEFAULT_KERNEL_VERSION="3.8.13"
BR2_EXTRA_GCC_CONFIG_OPTIONS="--with-fpu=vfpv3 --with-float=hard"
# BR2_SOFT_FLOAT is not set
BR2_TOOLCHAIN_BUILDROOT_LARGEFILE=y
BR2_TOOLCHAIN_BUILDROOT_WCHAR=y
BR2_TOOLCHAIN_BUILDROOT_CXX=y
BR2_TARGET_GENERIC_HOSTNAME="beaglebone"
BR2_ROOTFS_DEVICE_CREATION_DYNAMIC_DEVTMPFS=y
BR2_INIT_NONE=y
BR2_TARGET_GENERIC_ROOT_PASSWD="root"
BR2_TARGET_GENERIC_GETTY_PORT="ttyO0"
# BR2_TARGET_GENERIC_REMOUNT_ROOTFS_RW is not set
BR2_ROOTFS_OVERLAY="board/beagleboneblack/rootfs-additions"
BR2_ROOTFS_POST_IMAGE_SCRIPT="board/beagleboneblack/post-createfs.sh"
# BR2_PACKAGE_BUSYBOX is not set
BR2_PACKAGE_E2FSPROGS=y
# BR2_PACKAGE_E2FSPROGS_BADBLOCKS is not set
# BR2_PACKAGE_E2FSPROGS_CHATTR is not set
# BR2_PACKAGE_E2FSPROGS_DUMPE2FS is not set
# BR2_PACKAGE_E2FSPROGS_E2FREEFRAG is not set
# BR2_PACKAGE_E2FSPROGS_E2FSCK is not set
# BR2_PACKAGE_E2FSPROGS_E2LABEL is not set
# BR2_PACKAGE_E2FSPROGS_E2UNDO is not set
# BR2_PACKAGE_E2FSPROGS_FILEFRAG is not set
# BR2_PACKAGE_E2FSPROGS_FINDFS is not set
# BR2_PACKAGE_E2FSPROGS_FSCK is not set
# BR2_PACKAGE_E2FSPROGS_LOGSAVE is not set
# BR2_PACKAGE_E2FSPROGS_LSATTR is not set
# BR2_PACKAGE_E2FSPROGS_MKLOSTFOUND is not set
# BR2_PACKAGE_E2FSPROGS_TUNE2FS is not set
# BR2_PACKAGE_E2FSPROGS_UUIDGEN is not set
BR2_PACKAGE_AM335X_PRU_PACKAGE=y
BR2_PACKAGE_ERLANG=y
BR2_PACKAGE_ERLINIT=y
BR2_PACKAGE_HOST_AM335X_PRU_PACKAGE=y
BR2_PACKAGE_HOST_DOSFSTOOLS=y
BR2_PACKAGE_HOST_GENIMAGE=y
BR2_PACKAGE_HOST_GENPART=y
BR2_PACKAGE_HOST_MTOOLS=y
BR2_TARGET_ROOTFS_EXT2=y
BR2_TARGET_ROOTFS_EXT2_4=y
# BR2_TARGET_ROOTFS_TAR is not set
BR2_TARGET_UBOOT=y
BR2_TARGET_UBOOT_BOARDNAME="am335x_evm"
BR2_TARGET_UBOOT_CUSTOM_PATCH_DIR="board/beagleboneblack/uboot"
BR2_TARGET_UBOOT_FORMAT_IMG=y
BR2_TARGET_UBOOT_SPL=y
BR2_TARGET_UBOOT_SPL_NAME="MLO"
BR2_LINUX_KERNEL=y
BR2_LINUX_KERNEL_CUSTOM_VERSION=y
BR2_LINUX_KERNEL_CUSTOM_VERSION_VALUE="3.8.13"
BR2_LINUX_KERNEL_PATCH="http://rcn-ee.net/deb/sid-armhf/v3.8.13-bone22/patch-3.8.13-bone22.diff.gz board/beagleboneblack/linux-3.8"
BR2_LINUX_KERNEL_USE_CUSTOM_CONFIG=y
BR2_LINUX_KERNEL_CUSTOM_CONFIG_FILE="board/beagleboneblack/linux-3.8.config"
BR2_LINUX_KERNEL_DTS_SUPPORT=y
BR2_LINUX_KERNEL_INTREE_DTS_NAME="am335x-boneblack"
BR2_LINUX_KERNEL_INSTALL_TARGET=y
```

## configs/beagleboneblack_defconfig
```kconfig
BR2_arm=y
BR2_cortex_a8=y
BR2_ARM_EABIHF=y
BR2_ARM_FPU_VFPV3=y
BR2_CCACHE=y
BR2_TOOLCHAIN_EXTERNAL=y
BR2_TARGET_GENERIC_HOSTNAME="beaglebone"
BR2_TARGET_GENERIC_GETTY_PORT="ttyO0"
# BR2_TARGET_GENERIC_REMOUNT_ROOTFS_RW is not set
BR2_LINUX_KERNEL=y
BR2_LINUX_KERNEL_CUSTOM_VERSION=y
BR2_LINUX_KERNEL_CUSTOM_VERSION_VALUE="3.8.13"
BR2_LINUX_KERNEL_PATCH="http://rcn-ee.net/deb/sid-armhf/v3.8.13-bone28/patch-3.8.13-bone28.diff.gz board/beagleboneblack/linux-3.8"
BR2_LINUX_KERNEL_USE_CUSTOM_CONFIG=y
BR2_LINUX_KERNEL_CUSTOM_CONFIG_FILE="board/beagleboneblack/linux-3.8.config"
BR2_LINUX_KERNEL_DTS_SUPPORT=y
BR2_LINUX_KERNEL_INTREE_DTS_NAME="am335x-boneblack"
BR2_LINUX_KERNEL_INSTALL_TARGET=y
BR2_TARGET_ROOTFS_EXT2=y
# BR2_TARGET_ROOTFS_TAR is not set
BR2_TARGET_UBOOT=y
BR2_TARGET_UBOOT_BOARDNAME="am335x_evm"
BR2_TARGET_UBOOT_FORMAT_IMG=y
BR2_TARGET_UBOOT_SPL=y
BR2_TARGET_UBOOT_SPL_NAME="MLO"
```

## package/am335x-pru-package/Config.in.host
```kconfig
config BR2_PACKAGE_HOST_AM335X_PRU_PACKAGE
	bool "host am335x-pru-package"
	depends on BR2_arm # only relevant for TI am335x
	help
	  AM335X PRU assembler

	  https://github.com/beagleboard/am335x_pru_package
```

## package/angularjs/Config.in
```kconfig
config BR2_PACKAGE_ANGULARJS
	bool "AngularJS"
	help
	  AngularJS is an open-source JavaScript framework,
	  maintained by Google, that assists with running
	  single-page applications.

	  http://angularjs.com
```

## package/beagle-capes/Config.in
```kconfig
config BR2_PACKAGE_BEAGLE_CAPES
	bool "beagle-capes"
	depends on BR2_LINUX_KERNEL && BR2_arm
	select BR2_LINUX_KERNEL_INSTALL_FIRMWARE
	help
	  Installs beaglebone capes firmware from the kernel source.

	  This package requires that a kernel with beaglebone capes firmware is
	  selected.

comment "requires the linux kernel"
	depends on !(BR2_LINUX_KERNEL)
```

## package/erlang-cowboy/Config.in
```kconfig
config BR2_PACKAGE_ERLANG_COWBOY
	bool "erlang-cowboy"
	depends on BR2_PACKAGE_ERLANG
	select BR2_PACKAGE_ERLANG_RANCH
	help
	  Small, fast, modular HTTP server written in Erlang.

	  http://github.com/extend/cowboy
```

## package/erlang-goldrush/Config.in
```kconfig
config BR2_PACKAGE_ERLANG_GOLDRUSH
	bool "erlang-goldrush"
	depends on BR2_PACKAGE_ERLANG
	help
	  Small, fast event processing and monitoring for Erlang/OTP
	  applications.

	  http://github.com/DeadZen/goldrush
```

## package/erlang-gpio/Config.in
```kconfig
config BR2_PACKAGE_ERLANG_GPIO
	bool "erlang-gpio"
	depends on BR2_PACKAGE_ERLANG
	select BR2_PACKAGE_ERLANG_LAGER
	help
	  Sysfs GPIO port driver and Erlang module

	  http://github.com/feuerlabs/gpio
```

## package/erlang-lager/Config.in
```kconfig
config BR2_PACKAGE_ERLANG_LAGER
	bool "erlang-lager"
	depends on BR2_PACKAGE_ERLANG
	select BR2_PACKAGE_ERLANG_GOLDRUSH
	help
	  A logging framework for Erlang/OTP

	  http://github.com/basho/lager
```

## package/erlang-nerves/Config.in
```kconfig
config BR2_PACKAGE_ERLANG_NERVES
	bool "erlang-nerves"
	depends on BR2_PACKAGE_ERLANG
	help
	  LED control via sysfs in Erlang

	  http://github.com/nerves/nerves
```

## package/erlang-netlink/Config.in
```kconfig
config BR2_PACKAGE_ERLANG_NETLINK
	bool "erlang-netlink"
	depends on BR2_PACKAGE_ERLANG
	select BR2_PACKAGE_ERLANG_LAGER
	help
	  Erlang support for the Netlink protocol

	  http://github.com/feuerlabs/netlink
```

## package/erlang-procket/Config.in
```kconfig
config BR2_PACKAGE_ERLANG_PROCKET
	bool "erlang-procket"
	depends on BR2_PACKAGE_ERLANG
	select BR2_PACKAGE_LIBPCAP
	help
	  Erlang interface to low level socket operations

	  http://github.com/msantos/procket
```

## package/erlang-ranch/Config.in
```kconfig
config BR2_PACKAGE_ERLANG_RANCH
	bool "erlang-ranch"
	depends on BR2_PACKAGE_ERLANG
	help
	  Socket acceptor pool for TCP protocols.

	  http://github.com/extend/ranch
```

## package/erlang-rebar/Config.in
```kconfig
config BR2_PACKAGE_ERLANG_REBAR
	bool "erlang-rebar"
	depends on BR2_PACKAGE_ERLANG
	help
	  Erlang build tool that makes it easy to compile and test Erlang
	  applications, port drivers and releases.

	  http://gihub.com/rebar/rebar
```

## package/erlang-relx/Config.in
```kconfig
config BR2_PACKAGE_ERLANG_RELX
	bool "erlang-relx"
	depends on BR2_PACKAGE_ERLANG
	select BR2_PACKAGE_ERLANG_REBAR
	help
	  A release assembler for Erlang.

	  http://github.com/erlware/relx
```

## package/erlcam/Config.in
```kconfig
config BR2_PACKAGE_ERLCAM
	bool "erlcam"
	select BR2_PACKAGE_ERLANG_COWBOY
	help
	  Erlang camera test application.

	  http://github.com/fhunleth/erlcam
```

## package/erlinit/Config.in
```kconfig
config BR2_PACKAGE_ERLINIT
	bool "erlinit"
	help
	  Erlinit is a replacement for /sbin/init that starts erlang.

	  https://github.com/fhunleth/erlinit
```

## package/nerves-demo/Config.in
```kconfig
config BR2_PACKAGE_NERVES_DEMO
	bool "nerves-demo"
	depends on BR2_PACKAGE_ERLANG
	help
	  Nerves demonstration application

	  http://bitbucket.org/fhunleth/erlang_webcontrol
```
